## layers/meta-fastboot-poc/conf/layer.conf
```bitbake
# We have a conf and classes directory, add to BBPATH
BBPATH .= ":${LAYERDIR}"

# We have recipes-* directories, add to BBFILES
BBFILES += "${LAYERDIR}/recipes-*/*/*.bb \
            ${LAYERDIR}/recipes-*/*/*.bbappend"

BBFILE_COLLECTIONS += "meta-fastboot-poc"
BBFILE_PATTERN_meta-fastboot-poc = "^${LAYERDIR}/"
BBFILE_PRIORITY_meta-fastboot-poc = "6"

LAYERDEPENDS_meta-fastboot-poc = "core"
LAYERSERIES_COMPAT_meta-fastboot-poc = "dunfell kirkstone"

IMAGE_INSTALL:append = " \
    drm-color-bar \
"

KERNEL_DEVICETREE:append = " \
    renesas/r8a779g0-whitehawk_cr52_rproc.dtb \
"
```

## layers/meta-xt-gles_common/conf/layer.conf
```bitbake
# We have a conf and classes directory, add to BBPATH
BBPATH =. "${LAYERDIR}:"

# We have recipes-* directories, add to BBFILES
BBFILES += "${LAYERDIR}/recipes-*/*/*.bb \
            ${LAYERDIR}/recipes-*/*/*.bbappend"

BBFILE_COLLECTIONS += "prod-gles_common"
BBFILE_PATTERN_prod-gles_common = "^${LAYERDIR}/"
BBFILE_PRIORITY_prod-gles_common = "12"

LAYERSERIES_COMPAT_prod-gles_common = "kirkstone"
```

## layers/meta-xt-remote-proc/conf/layer.conf
```bitbake
# We have a conf and classes directory, add to BBPATH
BBPATH .= ":${LAYERDIR}"

# We have a packages directory, add to BBFILES
BBFILES += "${LAYERDIR}/recipes-*/*/*.bb \
            ${LAYERDIR}/recipes-*/*/*.bbappend"

BBFILE_COLLECTIONS += "xt-remote-proc"
BBFILE_PATTERN_xt-remote-proc := "^${LAYERDIR}/"
BBFILE_PRIORITY_xt-remote-proc = "12"

LAYERSERIES_COMPAT_xt-remote-proc = "kirkstone"
```
